## src/modules/mike_velocity_logger/Kconfig
```kconfig
menuconfig MODULES_MIKE_VELOCITY_LOGGER
	bool "mike_velocity_logger"
	default y
	---help---
		Enable Logging velocity estimates from integrated accelerometer data.
```
